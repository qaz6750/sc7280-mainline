## Documentation/devicetree/bindings/mfd/siliconmitus,sm5714.yaml
```yaml
# SPDX-License-Identifier: (GPL-2.0-only OR BSD-2-Clause)
%YAML 1.2
---
$id: http://devicetree.org/schemas/mfd/siliconmitus,sm5714.yaml#
$schema: http://devicetree.org/meta-schemas/core.yaml#

title: Silicon Mitus SM5714 multi-function device

maintainers:
  - XiaoYeZi <qaz6750@outlook.com>

description:
  The SM5714 combines a switching charger, fuel gauge and MUIC. The blocks
  use fixed secondary I2C addresses managed by the parent MFD driver.

properties:
  compatible:
    const: siliconmitus,sm5714

  reg:
    const: 0x49

  interrupts:
    maxItems: 1

  wakeup-source: true

  charger:
    type: object
    properties:
      compatible:
        const: siliconmitus,sm5714-charger

      monitored-battery:
        $ref: /schemas/types.yaml#/definitions/phandle
        description: Phandle to the battery characteristics node.

      usb-otg-vbus:
        $ref: /schemas/regulator/regulator.yaml#
        description: Regulator controlling the charger boost output on VBUS.

    required:
      - compatible

    additionalProperties: false

  fuel-gauge:
    type: object
    properties:
      compatible:
        const: siliconmitus,sm5714-fuel-gauge

      power-supplies:
        $ref: /schemas/types.yaml#/definitions/phandle-array
        items:
          maxItems: 1
        description: Phandle to the SM5714 charger power supply.

    required:
      - compatible

    additionalProperties: false

required:
  - compatible
  - reg
  - charger
  - fuel-gauge

additionalProperties: false

examples:
  - |
    #include <dt-bindings/interrupt-controller/irq.h>

    i2c {
        #address-cells = <1>;
        #size-cells = <0>;

        pmic@49 {
            compatible = "siliconmitus,sm5714";
            reg = <0x49>;
            interrupt-parent = <&tlmm>;
            interrupts = <54 IRQ_TYPE_LEVEL_LOW>;
            wakeup-source;

            charger {
                compatible = "siliconmitus,sm5714-charger";

                usb_otg_vbus: usb-otg-vbus {
                    regulator-name = "sm5714-usb-otg-vbus";
                };
            };

            fuel-gauge {
                compatible = "siliconmitus,sm5714-fuel-gauge";
            };
        };
    };
```

## Documentation/devicetree/bindings/usb/siliconmitus,sm5714-typec.yaml
```yaml
# SPDX-License-Identifier: (GPL-2.0-only OR BSD-2-Clause)
%YAML 1.2
---
$id: http://devicetree.org/schemas/usb/siliconmitus,sm5714-typec.yaml#
$schema: http://devicetree.org/meta-schemas/core.yaml#

title: Silicon Mitus SM5714 USB Type-C Port Controller

maintainers:
  - XiaoYeZi <qaz6750@outlook.com>

description:
  The SM5714 contains a USB Type-C CC and Power Delivery controller. This
  binding describes its standalone I2C interface used for CC attachment,
  connector orientation and USB data-role detection.

properties:
  compatible:
    const: siliconmitus,sm5714-typec

  reg:
    maxItems: 1

  interrupts:
    maxItems: 1

  wakeup-source: true

  vbus-supply:
    description: Regulator supplying VBUS while the port is acting as source.

  connector:
    $ref: /schemas/connector/usb-connector.yaml#
    unevaluatedProperties: false

required:
  - compatible
  - reg
  - interrupts
  - vbus-supply
  - connector

additionalProperties: false

examples:
  - |
    #include <dt-bindings/interrupt-controller/irq.h>

    usb_otg_vbus: regulator-vbus {
        compatible = "regulator-fixed";
        regulator-name = "usb-otg-vbus";
    };

    i2c {
        #address-cells = <1>;
        #size-cells = <0>;

        typec@33 {
            compatible = "siliconmitus,sm5714-typec";
            reg = <0x33>;
            interrupt-parent = <&gpio>;
            interrupts = <142 IRQ_TYPE_LEVEL_LOW>;
            vbus-supply = <&usb_otg_vbus>;

            connector {
                compatible = "usb-c-connector";
                power-role = "dual";
                data-role = "dual";
            };
        };
    };
...
```

## drivers/input/touchscreen/focaltech-ft820x/Kconfig
```kconfig
# SPDX-License-Identifier: GPL-2.0-only

config TOUCHSCREEN_FOCALTECH_FT820X
	tristate "FocalTech FT820x touchscreen"
	depends on SPI
	select CRC_CCITT
	help
	  Say Y here to enable support for FocalTech FT820x touchscreen
	  controllers connected over SPI, including the FT8203.

	  To compile this driver as a module, choose M here: the module
	  will be called focaltech-ft820x.

config TOUCHSCREEN_FOCALTECH_FT820X_FW_DOWNLOAD
	bool "Build FT820x RAM firmware download support"
	depends on TOUCHSCREEN_FOCALTECH_FT820X=y
	default n
	help
	  Build the low-level ROM boot and RAM firmware download routines used
	  by FT820x controllers. This option does not add a userspace interface
	  and the touchscreen driver never invokes the routines during probe,
	  resume, interrupt recovery, or normal operation.

	  Say N unless a separate, explicit firmware update interface needs
	  these routines.
```
